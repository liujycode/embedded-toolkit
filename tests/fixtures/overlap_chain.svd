# OVERLAPCHAIN register map
Vendor: Test; File version: 1.0
Chain overlap fixture for lint
CPU: CM0
Registers are 32-bit, access not given, no defined reset value unless marked. A register's access mark holds for its fields unless they carry their own. Offsets are from the block's base; lines under a group give offsets from that group; [hi:lo] are bit positions; {n}, {i} and the like mark numbered series; 'fields as' and 'values as' point back to an identical list; <NAME> marks a mode.

## Memory map
0x50000000 P

## P
Base 0x50000000
0x00 REGA — bytes 0x00-0x03
0x01 REGB — bytes 0x01-0x04
0x02 REGC 64-bit — bytes 0x02-0x09
0x20 CLEAN — 不与其他寄存器重叠
0x40 REGF — 位域链式重叠
  [25:24] FZ — bits 24-25，不与上面三个重叠
  [8:2] FC — bits 2-8
  [6:1] FB — bits 1-6
  [4:0] FA — bits 0-4
