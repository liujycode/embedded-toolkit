# WOSYNTH register map
Vendor: SYNTH-Corp; File version: 1.0
Write-only register fixture
CPU: CM4 r0p1, little endian
Registers are 16-bit, write-only, reset 0x0 unless marked. A register's access mark holds for its fields unless they carry their own. Offsets are from the block's base; lines under a group give offsets from that group; [hi:lo] are bit positions; {n}, {i} and the like mark numbered series; 'fields as' and 'values as' point back to an identical list; <NAME> marks a mode.

## Memory map
0x50000000 PORTX size 0x100 — Write-only test port

## PORTX — Write-only test port
Base 0x50000000
0x00 BSRR — Bit set/reset register
0x04 ODR rw — Output data register
  [0] OD0
