# ALIASCHIP register map
Vendor: Test; File version: 1.0
Address alias fixture for inside_register
CPU: CM0
Registers are 32-bit, access not given, no defined reset value unless marked. A register's access mark holds for its fields unless they carry their own. Offsets are from the block's base; lines under a group give offsets from that group; [hi:lo] are bit positions; {n}, {i} and the like mark numbered series; 'fields as' and 'values as' point back to an identical list; <NAME> marks a mode.

## Memory map
0x40000000 P — Wide register with a narrow byte alias

## P — Wide register with a narrow byte alias
Base 0x40000000
0x00 W32 — 32-bit view at offset 0
0x02 B2 8-bit — 8-bit view at offset 2
0x10 AFTER — Next register, keeps the peripheral span open past 0x4
